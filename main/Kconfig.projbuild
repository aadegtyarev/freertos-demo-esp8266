## main/Kconfig.projbuild
```kconfig
menu "User Configuration"

    config BROKER_URL
        string "Broker URL"
        default "mqtt://192.168.2.108"
        help
            URL of the broker to connect to

    config BROKER_URL_FROM_STDIN
        bool
        default y if BROKER_URL = "FROM_STDIN"

    config WIFI_SSID
        string "WiFi SSID"
        default "WB-LAB"
        help
            SSID (network name) for the example to connect to.

    config WIFI_PASSWORD
        string "WiFi Password"
        default "08877922"

    config HOSTNAME
        string "Hostname"
        default "esp8266-demo-freertos"

endmenu
```
